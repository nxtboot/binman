// SPDX-License-Identifier: GPL-2.0+

/dts-v1/;

/ {
	#address-cells = <1>;
	#size-cells = <1>;
	compatible = "test,board", "test,soc";

	binman {
		blob-ext {
			filename = "fetched.bin";
		};
	};
};
